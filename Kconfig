## Kconfig
```kconfig
# SPDX-License-Identifier: MIT

menuconfig ZMK_DYNAMIC_SETTINGS
	bool "Dynamic settings"
	select SETTINGS
	select ZMK_DYNAMIC_SETTINGS_SCHEMA
	imply NVS
	help
	  Enable the Nemu-link typed settings store and generated settings schema.
	  Prefer NVS as the settings backend when the platform supports it. A
	  different backend can still be selected by the board configuration.

if ZMK_DYNAMIC_SETTINGS

config ZMK_DYNAMIC_SETTINGS_INIT_PRIORITY
	int "Settings preload init priority"
	range 1 99
	default 80
	help
	  Load Nemu-link settings before hardware drivers that consume reboot-required
	  settings during their POST_KERNEL initialization.

config ZMK_DYNAMIC_SETTINGS_SCHEMA
	bool "Generate the Nemu-link settings schema"
	default y
	help
	  Generate a per-build canonical-CBOR schema and embed its compressed form
	  in ROM for bounded Studio schema reads.

endif
```

## dts/bindings/sekigon,dynamic-setting.yaml
```yaml
description: Typed setting declared inside an Nemu-link settings group
compatible: "sekigon,dynamic-setting"
properties:
  setting-name:
    type: string
    required: true
  label:
    type: string
    required: true
  ui-subgroup:
    type: string
    required: false
  ui-component:
    type: string
    required: false
  value-type:
    type: string
    required: true
    enum: [bool, u8, u16, u32, s8, s16, s32, enum, text]
  default-bool:
    type: int
  default-int:
    type: int
  default-enum:
    type: string
  default-string:
    type: string
  minimum:
    type: int
  maximum:
    type: int
  step:
    type: int
  enum-values:
    type: string-array
  unit:
    type: string
  widget:
    type: string
    enum: [auto, checkbox, select, number, slider, bitmask, button, graph, textbox]
    default: auto
  text-length:
    type: int
    description: Maximum UTF-8 byte length for a text setting. The schema generator lowers it to the required number of u32 chunks.
  help:
    type: string
  read-only:
    type: boolean
  persistent:
    type: boolean
  volatile:
    type: boolean
    description: Do not store this setting in the settings cache or flash record.
  reboot-required:
    type: boolean
  max-length:
    type: int
  on-change:
    type: string
  runtime-field:
    type: string
    description: C member in the group's runtime target struct for declarative value copying
  default-property:
    type: string
```

## dts/bindings/sekigon,dynamic-settings-group.yaml
```yaml
description: Settings group backed by a device in this firmware image
compatible: "sekigon,dynamic-settings-group"
properties:
  module-name:
    type: string
    required: true
  group-name:
    type: string
    required: true
  instance-name:
    type: string
    required: true
  label:
    type: string
    required: true
  scope:
    type: string
    required: true
    enum: [local, shared, owner]
  kconfig-condition:
    type: string
    description: Emit this group only when the named Kconfig symbol is enabled
    required: false
  format-version:
    type: int
    required: true
  target-role:
    type: string
    required: false
  actual-device:
    type: phandle
  default-provider:
    type: string
    required: false
  default-provider-context-free:
    type: boolean
    description: The default provider does not require an actual device context
    required: false
  runtime-read-provider:
    type: string
    required: false
  record-type:
    type: string
    required: false
  record-max-length:
    type: int
    required: false
  record-default:
    type: array
    required: false
  record-on-change:
    type: string
  runtime-struct-header:
    type: string
    description: Header that defines the runtime target struct
  runtime-struct-type:
    type: string
    description: C struct tag used by runtime-field bindings
  runtime-apply-provider:
    type: string
    description: Optional group-level post-copy handler for side effects
    required: false
  runtime-lock-field:
    type: string
    description: k_spinlock member in the runtime target struct
    required: false
```

## dts/bindings/sekigon,dynamic-settings-proxy-group.yaml
```yaml
description: Remote settings group described by this firmware image
compatible: "sekigon,dynamic-settings-proxy-group"
include: sekigon,dynamic-settings-group.yaml
properties:
  target-id:
    type: string
    required: true
  target-role:
    type: string
    required: false
  target-source:
    type: int
    required: false
```
